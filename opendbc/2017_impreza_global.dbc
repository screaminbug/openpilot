VERSION ""

NS_ :

BS_:

BU_: XXX

BO_ 64 NEW_MSG_1: 8 XXX
 SG_ counter : 11|4@0+ (1,0) [0|255] "" XXX
